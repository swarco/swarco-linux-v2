## buildroot/buildroot-1.0/package/bluez-libs/Config.in
```kconfig
config BR2_PACKAGE_BLUEZ-LIBS
	bool "bluez-libs"
	default n
	help
	  Bluetooth libs
```

## buildroot/buildroot-1.0/package/fuser/Config.in
```kconfig
config BR2_PACKAGE_FUSER
        bool "fuser (from psmisc package)"
	default n
	help
	  fuser utility from psmisc package
```

## buildroot/buildroot-1.0/package/zeroconf/Config.in
```kconfig
config BR2_PACKAGE_ZEROCONF
	bool "zeroconf"
	default n
	help
		IPv4LL implementation.
	  
```

## buildroot/buildroot-1.0/target/all/Config.in
```kconfig
config BR2_TARGET_ALL_CONF
	bool "all changed configs"
	default y
	help
	  Set Weiss Configuration files.
```

## buildroot/buildroot-2.0/swarco/old_package/imagemagick/Config.in
```kconfig
config BR2_PACKAGE_IMAGEMAGICK
        bool "imagemagick"
	default n
	help
	  imagemagick programm to manipulate jpeg files
```

## buildroot/buildroot-2.0/swarco/old_package/nmbd/Config.in
```kconfig
config BR2_PACKAGE_NMBD
        bool "nmbd server"
	default n
	help
	  NMBD Server
	  derived from Samba server package.
	  Includes only name resolution.
```

## buildroot/buildroot-2.0/swarco/old_package/setserial/Config.in
```kconfig
config BR2_PACKAGE_SETSERIAL
        bool "setserial"
	default n
	help
	  setserial utility: controls configuration of serial ports
```

## buildroot/buildroot-2.0/swarco/package/Config.in
```kconfig
#commented packages are not necessary in current buildroot
#files are moved in old_package directory
comment "Weiss Stuff"
source "weiss/package/bluez-libs/Config.in"
source "weiss/package/bluez-utils/Config.in"
source "weiss/package/goahead/Config.in"
#source "weiss/package/samba_weiss/Config.in"
#source "weiss/package/nmbd/Config.in"
# source "weiss/package/fuser/Config.in" => now in psmisc
source "weiss/package/zeroconf/Config.in"
source "weiss/package/updatedd/Config.in"
source "weiss/package/sqlite/Config.in"
source "weiss/package/cifs/Config.in"
source "weiss/package/mgetty/Config.in"
#source "weiss/package/proftpd/Config.in"
#source "weiss/package/yaffs2/Config.in"
#source "weiss/package/perl/Config.in"
source "weiss/package/wuftpd/Config.in"
#source "weiss/package/imagemagick/Config.in"
source "weiss/package/qemacs/Config.in"
source "weiss/package/comgt/Config.in"
source "weiss/package/vlan/Config.in"
```

## buildroot/buildroot-2.0/swarco/package/cifs/Config.in
```kconfig
config BR2_PACKAGE_CIFS
	bool "cifs"
	default n
	help
	  Common Internet File System client
```

## buildroot/buildroot-2.0/swarco/package/mgetty/Config.in
```kconfig
config BR2_PACKAGE_MGETTY
        bool "mgetty"
	default n
	help
	  GETTY for external connections via modem (dialin).
```

## buildroot/buildroot-2.0/swarco/package/qemacs/Config.in
```kconfig
config BR2_PACKAGE_QEMACS
        bool "qemacs"
	default n
	help
	  QEmacs Editor
```

## buildroot/buildroot-2.0/swarco/package/sqlite/Config.in
```kconfig
config BR2_PACKAGE_SQLITE
        bool "sqlite"
	default n
	help
	  Small SQL-Database
```

## buildroot/buildroot-2.0/swarco/package/tinc/Config.in
```kconfig
config BR2_PACKAGE_TINC
	bool "tinc"
	select BR2_PACKAGE_LZO
	select BR2_PACKAGE_OPENSSL
 	help
	  tinc is a Virtual Private Network (VPN) daemon that uses
          tunnelling and encryption to create a secure private network
          between hosts on the Internet. tinc is Free Software and
          licensed under the GNU General Public License version 2 or
          later. Because the VPN appears to the IP level network code
          as a normal network device, there is no need to adapt any
          existing software. This allows VPN sites to share
          information with each other over the Internet without
          exposing any information to others.

          https://www.tinc-vpn.org/
```

## buildroot/buildroot-2.0/swarco/package/wuftpd/Config.in
```kconfig
config BR2_PACKAGE_WUFTPD
        bool "wuftpd"
	default n
	help
	  WU-FTPD Server
```

## buildroot/buildroot-2.0/weiss/old_package/proftpd/Config.in
```kconfig
config BR2_PACKAGE_PROFTPD
        bool "proftpd"
	default n
	help
	  WU-FTPD Server
```

## buildroot/buildroot-2.0/weiss/old_package/samba_weiss/Config.in
```kconfig
config BR2_PACKAGE_SAMBA_WEISS
        bool "samba server"
	default n
	help
	  SMB Server
```

## buildroot/buildroot-2.0/weiss/package/bluez-utils/Config.in
```kconfig
config BR2_PACKAGE_BLUEZ-UTILS
        bool "bluez-utils"
	default n
	help
	  Bluetooth Utils
```

## buildroot/buildroot-2.0/weiss/package/updatedd/Config.in
```kconfig
config BR2_PACKAGE_UPDATEDD
        bool "updatedd"
	default n
	help
	  DynDNS updater utilility updatedd
```

## buildroot/buildroot-2.0/weiss/package/yaffs2/Config.in
```kconfig
config BR2_PACKAGE_YAFFS2
        bool "yaffs2 NAND FS"
	default n
	help
	  YAFFS2 NAND FS
```
